&pm660_charger{
	qcom,battery-data = <&mtp_batterydata>;
	qcom,float-option = <1>;
	qcom,fcc-max-ua = <400000>;
	qcom,fv-max-uv = <4450000>;
	qcom,usb-icl-ua = <500000>;
	qcom,step-charging-enable;
	qcom,sw-jeita-enable;
};

&pm660_fg {
	qcom,fg-rsense-sel = <0>;
	qcom,fg-chg-term-current = <40>;
	qcom,fg-sys-term-current = <(-50)>;
	qcom,fg-chg-term-base-current = <30>;
	qcom,hold-soc-while-full;
	qcom,fg-recharge-voltage = <4420>;
	qcom,fg-recharge-soc-thr = <90>;
	qcom,fg-jeita-thresholds = <0 10 20 45>;
};
