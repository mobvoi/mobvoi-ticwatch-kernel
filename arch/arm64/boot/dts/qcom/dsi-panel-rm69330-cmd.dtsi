/*
 * Copyright (c) 2019, The Linux Foundation. All rights reserved.
 *
 * This program is free software; you can redistribute it and/or modify
 * it under the terms of the GNU General Public License version 2 and
 * only version 2 as published by the Free Software Foundation.
 *
 * This program is distributed in the hope that it will be useful,
 * but WITHOUT ANY WARRANTY; without even the implied warranty of
 * MERCHANTABILITY or FITNESS FOR A PARTICULAR PURPOSE.  See the
 * GNU General Public License for more details.
 */

&mdss_mdp {
	dsi_rm69330_cmd: qcom,mdss_dsi_rm69330_cmd {
		qcom,mdss-dsi-panel-name = "rm69330 cmd mode dsi panel";
		qcom,mdss-dsi-panel-controller = <&mdss_dsi0>;
		qcom,mdss-dsi-panel-type = "dsi_cmd_mode";
		qcom,mdss-dsi-panel-destination = "display_1";
		qcom,mdss-dsi-panel-framerate = <60>;
		qcom,mdss-dsi-virtual-channel-id = <0>;
		qcom,mdss-dsi-stream = <0>;
		qcom,mdss-dsi-panel-width = <454>;
		qcom,mdss-dsi-panel-height = <454>;
		qcom,mdss-dsi-h-front-porch = <20>;
		qcom,mdss-dsi-h-back-porch = <40>;
		qcom,mdss-dsi-h-pulse-width = <20>;
		qcom,mdss-dsi-h-sync-skew = <0>;
		qcom,mdss-dsi-v-back-porch = <12>;
		qcom,mdss-dsi-v-front-porch = <20>;
		qcom,mdss-dsi-v-pulse-width = <4>;
		qcom,mdss-dsi-h-left-border = <0>;
		qcom,mdss-dsi-h-right-border = <0>;
		qcom,mdss-dsi-v-top-border = <0>;
		qcom,mdss-dsi-v-bottom-border = <0>;
		qcom,mdss-dsi-bpp = <24>;
		qcom,mdss-dsi-color-order = "rgb_swap_rgb";
		qcom,mdss-dsi-underflow-color = <0xff>;
		qcom,mdss-dsi-border-color = <0>;
		qcom,mdss-dsi-pixel-packing = "tight";
		qcom,mdss-dsi-pixel-alignment = <0>;
		qcom,mdss-dsi-on-command = [
			15 01 00 00 00 00 02 FE 00
			15 01 00 00 00 00 02 35 00
			15 01 00 00 00 00 02 3A A7
			15 01 00 00 00 00 02 51 FF
			15 01 00 00 00 00 02 51 FF
			39 01 00 00 00 00 05 2A 00 0E 01 D3
			39 01 00 00 00 00 05 2B 00 00 01 C5
			15 01 00 00 00 00 02 13 00
			15 01 00 00 20 00 02 C4 00
			05 01 00 00 78 00 02 11 00
			05 01 00 00 40 00 02 29 00
			];
		qcom,mdss-dsi-off-command = [
			15 01 00 00 00 00 02 FE 00
			05 01 00 00 28 00 02 28 00
			05 01 00 00 78 00 02 10 00
			];
		qcom,mdss-dsi-on-command-state = "dsi_lp_mode";
		qcom,mdss-dsi-off-command-state = "dsi_hs_mode";
		qcom,mdss-dsi-idle-on-command = [
			15 01 00 00 00 00 02 FE 00
			05 01 00 00 00 00 01 39   /* Idle-Mode On */
			];
		qcom,mdss-dsi-idle-off-command = [
			15 01 00 00 00 00 02 FE 00
			05 01 00 00 00 00 01 38   /* Idle-Mode Off */
			];
		qcom,mdss-dsi-idle-on-command-state = "dsi_hs_mode";
		qcom,mdss-dsi-idle-off-command-state = "dsi_lp_mode";
		qcom,mdss-dsi-boost-mode-in-command = [
			15 01 00 00 00 00 02 FE 00
			15 01 00 00 00 00 02 66 02 /* Boost-Mode In */
			];
		qcom,mdss-dsi-boost-mode-out-command = [
			15 01 00 00 00 00 02 FE 00
			15 01 00 00 00 00 02 66 00 /* Boost-Mode Out */
			];
		qcom,mdss-dsi-boost-mode-in-command-state = "dsi_lp_mode";
		qcom,mdss-dsi-boost-mode-out-command-state = "dsi_hs_mode";
		qcom,mdss-dsi-h-sync-pulse = <1>;
		qcom,mdss-dsi-traffic-mode = "burst_mode";
		qcom,mdss-dsi-lane-map = "lane_map_0123";
		qcom,mdss-dsi-bllp-eof-power-mode;
		qcom,mdss-dsi-bllp-power-mode;
		qcom,mdss-dsi-lane-0-state;
		qcom,mdss-dsi-te-pin-select = <1>;
		qcom,mdss-dsi-te-dcs-command = <1>;
		qcom,mdss-dsi-te-check-enable;
		qcom,mdss-dsi-te-using-te-pin;
		qcom,mdss-dsi-panel-timings = [7d 25 1d 00 37 33
			22 27 1e 03 04 00];
		qcom,mdss-dsi-t-clk-post = <0x09>;
		qcom,mdss-dsi-t-clk-pre = <0x2c>;
		qcom,mdss-dsi-bl-min-level = <1>;
		qcom,mdss-dsi-bl-max-level = <255>;
		qcom,mdss-dsi-dma-trigger = "trigger_sw";
		qcom,mdss-dsi-mdp-trigger = "none";
		qcom,mdss-dsi-bl-pmic-control-type = "bl_ctrl_dcs";
		qcom,mdss-dsi-reset-sequence = <0 1>, <1 12>, <0 12>;
	};
};
