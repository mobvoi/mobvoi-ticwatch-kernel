/dts-v1/;
/plugin/;

#include "lemans-adp-air.dtsi"

/ {
	model = "Qualcomm Technologies, Inc. Lemans ADP AIR";
	compatible =  "qcom,lemans", "qcom,adp-air", "qcom,lemans-adp-air";
	qcom,board-id = <0x1010019 0>;
};
