#include "sa515m.dtsi"

/ {
	model = "Qualcomm Technologies, Inc. SA515M V2";
	compatible = "qcom,sa515m";
	qcom,msm-id = <418 0x20000>;
};

&soc {
	blsp1_uart2b_hs: uartb@830000 { /* BLSP1 UART2 : GPIO: 63,64,65,66 */
		compatible = "qcom,msm-hsuart-v14";
		reg = <0x830000 0x200>,
		    <0x804000 0x23000>;
		interrupts = <0 1 2>;
		status="ok";
	};
};
