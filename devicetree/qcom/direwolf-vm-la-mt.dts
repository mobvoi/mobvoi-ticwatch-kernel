/dts-v1/;

#include "direwolf-vm.dtsi"
#include "direwolf-vm-la-mt.dtsi"

/ {
	model = "Qualcomm Technologies, Inc. Direwolf Multi LA Virtual Machine";
	compatible = "qcom,direwolf";
	qcom,board-id = <0x2000001 0>;
};

