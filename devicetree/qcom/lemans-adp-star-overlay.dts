/dts-v1/;
/plugin/;

#include "lemans-adp-star.dtsi"

/ {
	model = "Qualcomm Technologies, Inc. Lemans ADP STAR";
	compatible = "qcom,lemans", "qcom,adp-star", "qcom,lemans-adp-star";
	qcom,board-id = <0x10019 0>;
};
