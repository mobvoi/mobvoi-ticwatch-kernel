## drivers/char/brcm/bbdpl/Kconfig
```kconfig
choice
    depends on SENSORS_SSP_BBD
    prompt "Choose serial connection with chip"
    default BCM_GPS_SPI_DRIVER

config BCM_GPS_TTY_DRIVER
    bool  "TTY"
    depends on TTY
    help
       Support for BRCM GPS UART driver.

config BCM_GPS_I2C_DRIVER
     bool "I2C"
     default n
     depends on I2C
     help
        Support for BRCM GPS I2C driver.
endchoice

config BCM_GPS_SPI_DRIVER
    tristate "BCM_GPS_SPI_DRIVER"
    default y
    help
        Support for BRCM GPS SPI driver.
```

## drivers/input/touchscreen/atmel_mxt/Kconfig
```kconfig
#
# Atmel Touchscreen driver configuration
#
menuconfig TOUCHSCREEN_ATMEL
	bool "Atmel Touchscreen"
	depends on I2C
	default n
	help
	  Say Y here if you have Atmel touch panel.
	  If unsure, say N.
```

## drivers/input/touchscreen/zinitix/Kconfig
```kconfig
#
# Zinitix Touchscreen driver configuration
#

config TOUCHSCREEN_ZINITIX_TS
        bool "Zinitix Touchscreen"
        default y
		depends on I2C
		help
		  Say Y here if you have Zinitix touch panel.
		  If unsure, say N.
```

## drivers/misc/gpio_vibrator/Kconfig
```kconfig
config GPIO_VIBRATOR
	bool "Gpio Simple Vibrator driver"
		default n
	---help---
	  Vibrator driver support for Gpio Control only.
	  If you want to use this driver, say Y or M here.
	  If unsure, say N.
```

## drivers/nfc/st21nfc/Kconfig
```kconfig
# SPDX-License-Identifier: GPL-2.0-only
config NFC_ST21NFC
        tristate "STMicroelectronics ST21NFCD NFC driver"
        depends on I2C
        ---help---
          STMicroelectronics ST21NFCD core driver. It implements the chipset
          NCI logic and hooks into the NFC kernel APIs. Physical layers will
          register against it.

          Say N if unsure.
```

## drivers/nfc/st54spi/Kconfig
```kconfig
config NFC_ST54SPI
	tristate "STMicroelectronics ST54SPI NFC driver"
    ---help---
	  STMicroelectronics ST21NFCD core driver. It implements the chipset
	  NCI logic and hooks into the NFC kernel APIs. Physical layers will
	  register against it.

	  Say N if unsure.
```
